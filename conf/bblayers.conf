## conf/bblayers.conf
```bitbake
LCONF_VERSION = "7"

BBPATH = "${TOPDIR}"
BBFILES ?= ""

BBLAYERS = " \
    ${BBLAYERS_OE} \
"

BBLAYERS_CHROMIUM_FIREFOX = " \
    /OE/build/oe-core/meta-browser/meta-chromium \
    /OE/build/oe-core/meta-browser/meta-firefox \
    /OE/build/oe-core/meta-clang \
    /OE/build/oe-core/meta-rust \
    /OE/build/oe-core/meta-python2 \
    /OE/build/oe-core/meta-openembedded/meta-oe \
    /OE/build/oe-core/openembedded-core/meta \
"
BBLAYERS_CLANG = " \
    /OE/build/oe-core/meta-clang \
    /OE/build/oe-core/openembedded-core/meta \
"
BBLAYERS_CHROMIUM = " \
    /OE/build/oe-core/meta-clang \
    /OE/build/oe-core/meta-browser/meta-chromium \
    /OE/build/oe-core/meta-openembedded/meta-oe \
    /OE/build/oe-core/openembedded-core/meta \
"
BBLAYERS_FIREFOX = " \
    /OE/build/oe-core/meta-browser/meta-firefox \
    /OE/build/oe-core/meta-clang \
    /OE/build/oe-core/meta-python2 \
    /OE/build/oe-core/meta-openembedded/meta-oe \
    /OE/build/oe-core/openembedded-core/meta \
"
BBLAYERS_QT5 = " \
    /OE/build/oe-core/meta-qt5 \
    /OE/build/oe-core/meta-python2 \
    /OE/build/oe-core/meta-openembedded/meta-oe \
    /OE/build/oe-core/openembedded-core/meta \
"
BBLAYERS_QT5_NO_PY2 = " \
    /OE/build/oe-core/meta-qt5 \
    /OE/build/oe-core/meta-openembedded/meta-oe \
    /OE/build/oe-core/openembedded-core/meta \
"
BBLAYERS_QT6 = " \
    /OE/build/oe-core/meta-qt6 \
    /OE/build/oe-core/meta-openembedded/meta-python \
    /OE/build/oe-core/meta-openembedded/meta-oe \
    /OE/build/oe-core/openembedded-core/meta \
"
BBLAYERS_BASE = " \
    /OE/build/oe-core/meta-openembedded/meta-oe \
    /OE/build/oe-core/openembedded-core/meta \
"
BBLAYERS_PYTHON = " \
    /OE/build/oe-core/meta-openembedded/meta-oe \
    /OE/build/oe-core/openembedded-core/meta \
    /OE/build/oe-core/meta-openembedded/meta-multimedia \
    /OE/build/oe-core/meta-openembedded/meta-python \
"
BBLAYERS_AWS = " \
    /OE/build/oe-core/meta-aws \
    /OE/build/oe-core/meta-openembedded/meta-python \
    /OE/build/oe-core/meta-openembedded/meta-networking \
    /OE/build/oe-core/meta-openembedded/meta-oe \
    /OE/build/oe-core/openembedded-core/meta \
"
BBLAYERS_CORE = " \
    /OE/build/oe-core/openembedded-core/meta \
"
BBLAYERS_PY2 = " \
    /OE/build/oe-core/meta-python2 \
    /OE/build/oe-core/meta-openembedded/meta-oe \
    /OE/build/oe-core/openembedded-core/meta \
"
BBLAYERS_RPI = " \
    /OE/build/oe-core/meta-raspberrypi \
    /OE/build/oe-core/openembedded-core/meta \
"
BBLAYERS_GPLV2 = " \
    /OE/build/oe-core/openembedded-core/meta \
    /OE/build/oe-core/meta-gplv2 \
"
BBLAYERS_ROS = " \
    /OE/build/oe-core/meta-ros/meta-ros2-rolling \
    /OE/build/oe-core/meta-ros/meta-ros2 \
    /OE/build/oe-core/meta-ros/meta-ros-common \
    /OE/build/oe-core/meta-openembedded/meta-filesystems \
    /OE/build/oe-core/meta-openembedded/meta-python \
    /OE/build/oe-core/meta-openembedded/meta-networking \
    /OE/build/oe-core/meta-openembedded/meta-multimedia \
    /OE/build/oe-core/meta-openembedded/meta-oe \
    /OE/build/oe-core/openembedded-core/meta \
"
BBLAYERS_WEBOS_ROS = " \
    /OE/build/oe-core/meta-security \
    /OE/build/oe-core/meta-webosose/meta-webos-smack \
    /OE/build/oe-core/meta-ros-webos \
    /OE/build/oe-core/meta-webosose/meta-webos-virtualization \
    /OE/build/oe-core/meta-webosose/meta-webos-updater \
    /OE/build/oe-core/meta-webosose/meta-webos-raspberrypi \
    /OE/build/oe-core/meta-raspberrypi \
    /OE/build/oe-core/meta-webosose/meta-webos \
    /OE/build/oe-core/meta-ros/meta-ros2-rolling \
    /OE/build/oe-core/meta-ros/meta-ros2 \
    /OE/build/oe-core/meta-ros/meta-ros-common \
    /OE/build/oe-core/meta-qt5 \
    /OE/build/oe-core/meta-webosose/meta-qt5-compat \
    /OE/build/oe-core/meta-python2 \
    /OE/build/oe-core/meta-virtualization \
    /OE/build/oe-core/meta-updater \
    /OE/build/oe-core/meta-openembedded/meta-filesystems \
    /OE/build/oe-core/meta-openembedded/meta-python \
    /OE/build/oe-core/meta-openembedded/meta-networking \
    /OE/build/oe-core/meta-openembedded/meta-multimedia \
    /OE/build/oe-core/meta-openembedded/meta-oe \
    /OE/build/oe-core/openembedded-core/meta \
"
BBLAYERS_VIRT = " \
    /OE/build/oe-core/meta-virtualization \
    /OE/build/oe-core/meta-openembedded/meta-networking \
    /OE/build/oe-core/meta-openembedded/meta-filesystems \
    /OE/build/oe-core/meta-openembedded/meta-python \
    /OE/build/oe-core/meta-openembedded/meta-oe \
    /OE/build/oe-core/openembedded-core/meta \
"
BBLAYERS_UPDATER = " \
    /OE/build/oe-core/meta-openembedded/meta-filesystems \
    /OE/build/oe-core/meta-openembedded/meta-python \
    /OE/build/oe-core/meta-updater \
    /OE/build/oe-core/meta-openembedded/meta-oe \
    /OE/build/oe-core/openembedded-core/meta \
"
BBLAYERS_OE = " \
    /OE/build/oe-core/meta-browser/meta-chromium \
    /OE/build/oe-core/meta-raspberrypi \
    /OE/build/oe-core/meta-openembedded/meta-networking \
    /OE/build/oe-core/meta-openembedded/meta-python \
    /OE/build/oe-core/meta-virtualization \
    /OE/build/oe-core/meta-security \
    /OE/build/oe-core/meta-clang \
    /OE/build/oe-core/meta-openembedded/meta-filesystems \
    /OE/build/oe-core/meta-openembedded/meta-initramfs \
    /OE/build/oe-core/meta-openembedded/meta-perl \
    /OE/build/oe-core/meta-openembedded/meta-webserver \
    /OE/build/oe-core/meta-openembedded/meta-gnome \
    /OE/build/oe-core/meta-openembedded/meta-xfce \
    /OE/build/oe-core/meta-openembedded/meta-multimedia \
    /OE/build/oe-core/meta-smartphone/meta-android \
    /OE/build/oe-core/meta-openembedded/meta-oe \
    /OE/build/oe-core/openembedded-core/meta \
"
FOO = " \
    /OE/build/oe-core/meta-intel \
    /OE/build/oe-core/meta-yocto-bsp \
    /OE/build/oe-core/meta-poky \
    /OE/build/oe-core/meta-ros \
    /OE/build/oe-core/meta-gplv2 \
    /OE/build/oe-core/meta-tegra \
    /OE/build/oe-core/meta-openembedded/meta-initramfs \
    /OE/build/oe-core/meta-openembedded/meta-gnome \
    /OE/build/oe-core/meta-openembedded/meta-webserver \
    /OE/build/oe-core/meta-gir/meta-gir \
    /OE/build/oe-core/meta-gir/meta-gir-clutter \
    /OE/build/oe-core/meta-gir/meta-gir-core \
    /OE/build/oe-core/meta-gir/meta-gir-gnome \
    /OE/build/oe-core/meta-smartphone/meta-openmoko \
    /OE/build/oe-core/meta-smartphone/meta-shr \
    /OE/build/oe-core/meta-smartphone/meta-aurora \
    /OE/build/oe-core/meta-smartphone/meta-android \
"
```

## conf/local.conf
```bitbake
WEBOS_DISTRO_TOPDIR_BRANCH = "kirkstone"
DISTRO_BUILD_NAME = "luneos-${WEBOS_DISTRO_TOPDIR_BRANCH}"
SETUP_COMMON_DIR:forcevariable = "/OE/build/${DISTRO_BUILD_NAME}"

require /OE/build/oe-builds-luneos.conf
```
